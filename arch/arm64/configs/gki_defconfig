## drivers/block/zram/Kconfig
```kconfig
# SPDX-License-Identifier: GPL-2.0
config ZRAM
	tristate "Compressed RAM block device support"
	depends on BLOCK && SYSFS && ZSMALLOC && CRYPTO
	select CRYPTO_LZO
	help
	  Creates virtual block devices called /dev/zramX (X = 0, 1, ...).
	  Pages written to these disks are compressed and stored in memory
	  itself. These disks allow very fast I/O and compression provides
	  good amounts of memory savings.

	  It has several use cases, for example: /tmp storage, use as swap
	  disks and maybe many more.

	  See Documentation/admin-guide/blockdev/zram.rst for more information.

config ZRAM_AUTO_RESIZE
	bool "Auto initialize zram disksize from physical RAM"
	depends on ZRAM
	help
	  If enabled, zram devices are initialized automatically at boot with
	  a disksize derived from total physical RAM, instead of requiring
	  userspace to write /sys/block/zramX/disksize.

config ZRAM_AUTO_RESIZE_PERCENT
	int "zram auto-resize percent of total RAM"
	depends on ZRAM_AUTO_RESIZE
	range 1 400
	default 50
	help
	  Percentage of total physical RAM used as zram disksize when
	  CONFIG_ZRAM_AUTO_RESIZE is enabled.

config ZRAM_WRITEBACK
       bool "Write back incompressible or idle page to backing device"
       depends on ZRAM
       help
	 With incompressible page, there is no memory saving to keep it
	 in memory. Instead, write it out to backing device.
	 For this feature, admin should set up backing device via
	 /sys/block/zramX/backing_dev.

	 With /sys/block/zramX/{idle,writeback}, application could ask
	 idle page's writeback to the backing device to save in memory.

	 See Documentation/admin-guide/blockdev/zram.rst for more information.

config ZRAM_MEMORY_TRACKING
	bool "Track zRam block status"
	depends on ZRAM && DEBUG_FS
	help
	  With this feature, admin can track the state of allocated blocks
	  of zRAM. Admin could see the information via
	  /sys/kernel/debug/zram/zramX/block_state.

	  See Documentation/admin-guide/blockdev/zram.rst for more information.
```

## drivers/staging/binder_prio/Kconfig
```kconfig
config BINDER_PRIO
	tristate "Xiaomi binder prio"
	default y

if BINDER_PRIO

config BINDER_PRIO_DEBUG
	bool "Debug"

endif
```

## fs/map_spoof/Kconfig
```kconfig
menu "map spoof"

config MAP_SPOOF
	bool "basic map spoof"
	default y
	help
	  zeroes

endmenu
```

## lib/lz4p/Kconfig
```kconfig
config XRING_ZRAM_LZ4P
	bool "XRING ZRAM LZ4P"
	default n
	help
	  Choose this option to enable zram lz4p.
	  When enable this option, ZRAM enables LZ4P compress and decompress algorithm.
```
