/*
 * DoraCore: cupid overlay with the 144 Hz display overclock timing.
 * Packed as an optional dtbo.img variant; the default dtbo.img keeps
 * cupid-sm8450-pm8008-overlay.dtbo.
 */
#include "cupid-sm8450-pm8008-overlay.dts"
#include "display/display/cupid-panel-oc-144hz.dtsi"
