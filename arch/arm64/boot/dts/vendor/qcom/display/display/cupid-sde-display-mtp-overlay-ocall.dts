/*
 * DoraCore: cupid display overlay with every display overclock timing
 * (146 Hz and 155 Hz TE). Packed as an optional dtbo.img variant; the
 * default dtbo.img keeps cupid-sde-display-mtp-overlay.dtbo.
 */
#include "cupid-sde-display-mtp-overlay.dts"
#include "cupid-panel-oc-144hz.dtsi"
#include "cupid-panel-oc-156hz.dtsi"
