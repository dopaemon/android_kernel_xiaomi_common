/*
 * DoraCore: mayfly display overlay with the 144 Hz (146 Hz TE) overclock timing.
 * Packed as an optional dtbo.img variant; the default dtbo.img keeps
 * mayfly-sde-display-mtp-overlay.dtbo.
 */
#include "mayfly-sde-display-mtp-overlay.dts"
#include "mayfly-panel-oc-144hz.dtsi"
