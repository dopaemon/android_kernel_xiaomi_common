/*
 * DoraCore: mayfly overlay with every display overclock timing
 * (144 Hz and 156 Hz). Packed as an optional dtbo.img variant; the
 * default dtbo.img keeps mayfly-sm8475-pm8008-overlay.dtbo.
 */
#include "mayfly-sm8475-pm8008-overlay.dts"
#include "display/display/mayfly-panel-oc-144hz.dtsi"
#include "display/display/mayfly-panel-oc-156hz.dtsi"
