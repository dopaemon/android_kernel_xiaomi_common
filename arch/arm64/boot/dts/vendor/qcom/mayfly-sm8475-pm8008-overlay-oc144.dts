/*
 * DoraCore: mayfly overlay with the 144 Hz display overclock timing.
 * Packed as an optional dtbo.img variant; the default dtbo.img keeps
 * mayfly-sm8475-pm8008-overlay.dtbo.
 */
#include "mayfly-sm8475-pm8008-overlay.dts"
#include "display/display/mayfly-panel-oc-144hz.dtsi"
